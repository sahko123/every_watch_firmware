/*
 * MCUboot DTS overlay for Every Watch.
 *
 * Strip sensor/peripheral nodes that would pull in Kconfig symbols
 * MCUboot doesn't have (RTC_ALARM, SPI sensors, etc.).
 */

/ {
	aliases {
		/delete-property/ rtc0;
		/delete-property/ batt0;
		/delete-property/ light0;

		/* Required by CONFIG_BOOT_USB_DFU_GPIO -- io.c hard-#errors without
		 * it. MCUboot samples this pin before booting the app: held = stay
		 * in USB DFU indefinitely, released = boot normally with no delay. */
		mcuboot-button0 = &button_left;

		/* EXPERIMENTAL — feasibility test, see RECOVERY.md "The watchdog
		 * must start in MCUboot". Not wired to anything yet. */
		watchdog0 = &wdt0;
	};
};

&i2c0 {
	/delete-node/ frtc8900@32;
	/delete-node/ bmi270@68;
	/delete-node/ bh1750@23;
	/delete-node/ bq27441@55;
};

/* On-die temperature sensor — MCUboot has no use for it, but the node is
 * enabled by default in the SoC devicetree, which pulls in a driver
 * (drivers/sensor/nordic/temp) for 302 bytes of dead weight in a partition
 * that's nearly full. Found via `ninja rom_report` on the mcuboot subimage. */
&temp {
	status = "disabled";
};

/* USB stays enabled — MCUboot uses it for USB DFU mode */
